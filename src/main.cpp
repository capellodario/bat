
#include <Arduino.h>
#include <SPI.h>
#include <Wire.h>
#include <Adafruit_GFX.h>
#include <Adafruit_SH110X.h>
#include <Adafruit_Sensor.h>
#include <Adafruit_BME280.h>


// pin di ingresso per ultrasonic sensor
int trigPin = 2;
int echoPin = 4;

#define MAX_PREVIOUS_VALUES 16
int myvalue[MAX_PREVIOUS_VALUES];
int spacing = 0 ;

#define SEALEVELPRESSURE_HPA (1013.25)
const long interval = 10 * 60 * 1000 ;/// ogni quanto si attiva il sensore
bool functionToExecute = false;

#define Second_of_the_logo 5000 // seconds of logo show at the start

#define i2c_Address 0x3c //initialize with the I2C addr 0x3C Typically eBay OLED's
#define i2c_AddresBME 0x76 //initialize with the I2C addr of the bme sensor

#define SCREEN_WIDTH 128 // OLED display width, in pixels
#define SCREEN_HEIGHT 64 // OLED display height, in pixels
#define OLED_RESET -1   //   QT-PY / XIAO

Adafruit_SH1106G display = Adafruit_SH1106G(SCREEN_WIDTH, SCREEN_HEIGHT, &Wire, OLED_RESET);
Adafruit_BME280 bme;

/// starting sensor value//
float temperature = 17.91; // Celsius
float humidity = 45.69; //%
float pressure = 979.90; //hPa
float altitude =281.43 ; //m

// starting speed of sound
unsigned long soundSpeed = 343;

// TIMER
unsigned long previousMillis = 0; 


/////////////////////////////////////////// LOGO /////////////////////////////////////////////////////////////////////

// 'XOsa_0000_Layer 8', 64x64px
// 'XOsa_0000_Layer 8', 64x64px
const unsigned char epd_bitmap_XOsa_0000_Layer_8 [] PROGMEM = {
	0x00, 0x00, 0x00, 0x00, 0x00, 0x00, 0x00, 0x00, 0x00, 0x00, 0x00, 0x00, 0x00, 0x00, 0x00, 0x00, 
	0x00, 0x00, 0x00, 0x00, 0x00, 0x00, 0x00, 0x00, 0x00, 0x00, 0x00, 0x00, 0x00, 0x00, 0x00, 0x00, 
	0x00, 0x00, 0x00, 0x00, 0x00, 0x00, 0x00, 0x00, 0x00, 0x00, 0x00, 0x00, 0x00, 0x00, 0x00, 0x00, 
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	0x00, 0x00, 0x00, 0x00, 0x00, 0x00, 0x00, 0x00, 0x00, 0x00, 0x00, 0x00, 0x00, 0x00, 0x00, 0x00
};
// 'XOsa_0001_Layer 7', 64x64px
const unsigned char epd_bitmap_XOsa_0001_Layer_7 [] PROGMEM = {
	0x00, 0x00, 0x00, 0x00, 0x00, 0x00, 0x00, 0x00, 0x00, 0x00, 0x00, 0x00, 0x00, 0x00, 0x00, 0x00, 
	0x00, 0x00, 0x00, 0x00, 0x00, 0x00, 0x00, 0x00, 0x00, 0x00, 0x00, 0x00, 0x00, 0x00, 0x00, 0x00, 
	0x00, 0x00, 0x00, 0x00, 0x00, 0x00, 0x00, 0x00, 0x00, 0x00, 0x00, 0x00, 0x00, 0x00, 0x00, 0x00, 
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	0x00, 0x00, 0x00, 0x00, 0x00, 0x00, 0x00, 0x00, 0x00, 0x00, 0x00, 0x00, 0x00, 0x00, 0x00, 0x00
};
// 'XOsa_0002_Layer 6', 64x64px
const unsigned char epd_bitmap_XOsa_0002_Layer_6 [] PROGMEM = {
	0x00, 0x00, 0x00, 0x00, 0x00, 0x00, 0x00, 0x00, 0x00, 0x00, 0x00, 0x00, 0x00, 0x00, 0x00, 0x00, 
	0x00, 0x00, 0x00, 0x00, 0x00, 0x00, 0x00, 0x00, 0x00, 0x00, 0x00, 0x00, 0x00, 0x00, 0x00, 0x00, 
	0x00, 0x00, 0x00, 0x00, 0x00, 0x00, 0x00, 0x00, 0x00, 0x00, 0x00, 0x00, 0x00, 0x00, 0x00, 0x00, 
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	0x00, 0x00, 0x00, 0x00, 0x00, 0x00, 0x00, 0x00, 0x00, 0x00, 0x00, 0x00, 0x00, 0x00, 0x00, 0x00
};
// 'XOsa_0003_Layer 5', 64x64px
const unsigned char epd_bitmap_XOsa_0003_Layer_5 [] PROGMEM = {
	0x00, 0x00, 0x00, 0x00, 0x00, 0x00, 0x00, 0x00, 0x00, 0x00, 0x00, 0x00, 0x00, 0x00, 0x00, 0x00, 
	0x00, 0x00, 0x00, 0x00, 0x00, 0x00, 0x00, 0x00, 0x00, 0x00, 0x00, 0x00, 0x00, 0x00, 0x00, 0x00, 
	0x00, 0x00, 0x00, 0x00, 0x00, 0x00, 0x00, 0x00, 0x00, 0x00, 0x00, 0x00, 0x00, 0x00, 0x00, 0x00, 
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	0x00, 0x00, 0x00, 0x00, 0x00, 0x00, 0x00, 0x00, 0x00, 0x00, 0x00, 0x00, 0x00, 0x00, 0x00, 0x00
};
// 'XOsa_0004_Layer 4', 64x64px
const unsigned char epd_bitmap_XOsa_0004_Layer_4 [] PROGMEM = {
	0x00, 0x00, 0x00, 0x00, 0x00, 0x00, 0x00, 0x00, 0x00, 0x00, 0x00, 0x00, 0x00, 0x00, 0x00, 0x00, 
	0x00, 0x00, 0x00, 0x00, 0x00, 0x00, 0x00, 0x00, 0x00, 0x00, 0x00, 0x00, 0x00, 0x00, 0x00, 0x00, 
	0x00, 0x00, 0x00, 0x00, 0x00, 0x00, 0x00, 0x00, 0x00, 0x00, 0x00, 0x00, 0x00, 0x00, 0x00, 0x00, 
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	0x00, 0x00, 0x00, 0x00, 0x00, 0x00, 0x00, 0x00, 0x00, 0x00, 0x00, 0x00, 0x00, 0x00, 0x00, 0x00
};
// 'XOsa_0005_Layer 3', 64x64px
const unsigned char epd_bitmap_XOsa_0005_Layer_3 [] PROGMEM = {
	0x00, 0x00, 0x00, 0x00, 0x00, 0x00, 0x00, 0x00, 0x00, 0x00, 0x00, 0x00, 0x00, 0x00, 0x00, 0x00, 
	0x00, 0x00, 0x00, 0x00, 0x00, 0x00, 0x00, 0x00, 0x00, 0x00, 0x00, 0x00, 0x00, 0x00, 0x00, 0x00, 
	0x00, 0x00, 0x00, 0x00, 0x00, 0x00, 0x00, 0x00, 0x00, 0x00, 0x00, 0x00, 0x00, 0x00, 0x00, 0x00, 
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	0x00, 0x00, 0x00, 0x00, 0x00, 0x00, 0x00, 0x00, 0x00, 0x00, 0x00, 0x00, 0x00, 0x00, 0x00, 0x00
};
// 'XOsa_0006_Layer 2', 64x64px
const unsigned char epd_bitmap_XOsa_0006_Layer_2 [] PROGMEM = {
	0x00, 0x00, 0x00, 0x00, 0x00, 0x00, 0x00, 0x00, 0x00, 0x00, 0x00, 0x00, 0x00, 0x00, 0x00, 0x00, 
	0x00, 0x00, 0x00, 0x00, 0x00, 0x00, 0x00, 0x00, 0x00, 0x00, 0x00, 0x00, 0x00, 0x00, 0x00, 0x00, 
	0x00, 0x00, 0x00, 0x00, 0x00, 0x00, 0x00, 0x00, 0x00, 0x00, 0x00, 0x00, 0x00, 0x00, 0x00, 0x00, 
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	0x00, 0x00, 0x00, 0x00, 0x00, 0x00, 0x00, 0x00, 0x00, 0x00, 0x00, 0x00, 0x00, 0x00, 0x00, 0x00
};
// 'XOsa_0007_Layer 1', 64x64px
const unsigned char epd_bitmap_XOsa_0007_Layer_1 [] PROGMEM = {
	0x00, 0x00, 0x00, 0x00, 0x00, 0x00, 0x00, 0x00, 0x00, 0x00, 0x00, 0x00, 0x00, 0x00, 0x00, 0x00, 
	0x00, 0x00, 0x00, 0x00, 0x00, 0x00, 0x00, 0x00, 0x00, 0x00, 0x00, 0x00, 0x00, 0x00, 0x00, 0x00, 
	0x00, 0x00, 0x00, 0x00, 0x00, 0x00, 0x00, 0x00, 0x00, 0x00, 0x00, 0x00, 0x00, 0x00, 0x00, 0x00, 
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	0x00, 0x00, 0x00, 0x00, 0x00, 0x00, 0x00, 0x00, 0x00, 0x00, 0x00, 0x00, 0x00, 0x00, 0x00, 0x00
};

// Array of all bitmaps for convenience. (Total bytes used to store images in PROGMEM = 4224)
const int epd_bitmap_allArray_LEN = 8;
const unsigned char* epd_bitmap_allArray[8] = {
	epd_bitmap_XOsa_0000_Layer_8,
	epd_bitmap_XOsa_0001_Layer_7,
	epd_bitmap_XOsa_0002_Layer_6,
	epd_bitmap_XOsa_0003_Layer_5,
	epd_bitmap_XOsa_0004_Layer_4,
	epd_bitmap_XOsa_0005_Layer_3,
	epd_bitmap_XOsa_0006_Layer_2,
	epd_bitmap_XOsa_0007_Layer_1
};


void logo(){
	
	unsigned long currentTime = millis(); // Get the current time
  // Run the animation loop for 15 seconds
  while (currentTime < Second_of_the_logo) {
 // Loop through the bitmap array and display each image for a certain duration
  for (int i = 0; i < epd_bitmap_allArray_LEN; i++) {
    display.clearDisplay(); // Clear the display buffer
    // Display the bitmap image at index i
    display.drawBitmap(SCREEN_HEIGHT/2,2, epd_bitmap_allArray[i],64	,64,1);
    display.display(); // Display the drawn bitmap
    delay(10);       // Adjust the delay duration as needed for animation speed
		
		currentTime = millis(); // Update the current time
      if (currentTime >= Second_of_the_logo) {
        break;
      }
		}
	}	
}
///////////////////////////////////////////////////////////////////////////////////////////////////////////////////


void sensor_read_and_calculate(){

  temperature = bme.readTemperature(); // Celsius
  humidity = bme.readHumidity(); //%
  pressure = bme.readPressure() / 100.0F; //hPa
  altitude =bme.readAltitude(SEALEVELPRESSURE_HPA) ; //m
  
  // Convert altitude to Celsius
  float altitude_celsius = altitude - 273.15;
    // Calculate speed of sound
  soundSpeed = 331.4 + 0.606 * temperature + 0.0124 * humidity + 0.000657 * pressure - 0.00000128 * pressure * pressure + 0.00394 * altitude_celsius;
}



void drawcolum() {

  //int duration;
  int distance;
  unsigned long duration;
  // Sets the trigPin on HIGH state for 10 micro seconds
  digitalWrite(trigPin, HIGH);
  delayMicroseconds(10);
  digitalWrite(trigPin, LOW);
  // Reads the echoPin, returns the sound wave travel time in microseconds
  duration = pulseIn(echoPin, HIGH);
  // Calculating the distance
  distance = duration * soundSpeed / 20000;
  
  
  // uncomment to see the seriale
//   Serial.println(duration);
//   Serial.println(distance);

  // sorting one donw on the colum of array
	 for (int i = MAX_PREVIOUS_VALUES - 1; i > 0; i--) {
        myvalue[i] = myvalue[i - 1];
    }
  // adding the new value
	myvalue[0] = distance;
	
	display.clearDisplay(); // clean display
  //drawing the value;
	for (size_t i = 0; i < sizeof(myvalue) / sizeof(myvalue[0]); i++) {
    int yPos = i * spacing;
    display.setTextSize(1);      // Normal 1:1 pixel scale
    display.setTextColor(SH110X_WHITE); // Draw white text
    display.setCursor(23, yPos);  // Set cursor position
    display.println(myvalue[i]); // Display data
  }
  
  display.display(); // Show data on the display
  //delayMicroseconds(abs(duration)*10000);
  
  delay(map(distance,0,4000,50,300));
}

  

void setup(void){
 
  // PIN SETUP for SONIC SENSOR//
  pinMode(trigPin, OUTPUT); // Sets the trigPin as an Output
  pinMode(echoPin, INPUT); // Sets the echoPin as an Input
  digitalWrite(trigPin, LOW);

  // /////////// ///// ////////
  // uncomment for serial comunication
  //Serial.begin(9600);
 
  // Show image buffer on the display hardware.
  // Since the buffer is intialized with an Adafruit splashscreen
  // internally, this will display the splashscreen.

  delay(250); // wait for the OLED to power up
  display.begin(i2c_Address, true); // Address 0x3C default
  if (!bme.begin(i2c_AddresBME)) {
    //Serial.println("Could not find a valid BME280 sensor, check wiring!");
    while (1);
  }
  //display.setContrast (0); // dim display
  sensor_read_and_calculate();
  delay(10);
  // Clear the buffer.
  display.clearDisplay();
  	display.setRotation(2);
	logo();
	display.clearDisplay();
	// setup
  spacing = SCREEN_WIDTH / (sizeof(myvalue) / sizeof(myvalue[0])); // spacing for the colum of value;
	display.setRotation(3);
  // start timer
  previousMillis = millis();
}

void loop(void)
{
  unsigned long currentMillis = millis();

  if (currentMillis - previousMillis >= interval) {
        // Aggiorna il tempo dell'ultima esecuzione
        previousMillis = currentMillis;
        functionToExecute = true;
        // Chiamata alla tua funzione  
  }
  
  if (functionToExecute) {
        sensor_read_and_calculate();  // Esegui la tua funzione
        functionToExecute = false;  // Resetta il flag dopo aver eseguito la funzione
  }
  drawcolum();
}